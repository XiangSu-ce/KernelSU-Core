## kernel/Kconfig
```kconfig
menu "KernelSU"

config KSU
	tristate "KernelSU function support"
	depends on KPROBES
	default y
	help
	  Enable kernel-level root privileges on Android System.
	  Requires CONFIG_KPROBES for kernel hooking support.
	  To compile as a module, choose M here: the
	  module will be called kernelsu.

config KSU_DEBUG
	bool "KernelSU debug mode"
	depends on KSU
	default n
	help
	  Enable KernelSU debug mode.

config KSU_SILENT
	bool "KernelSU silent mode (suppress all log output)"
	depends on KSU
	default n
	help
	  Suppress all KernelSU log output at compile time.
	  When enabled, pr_info/pr_warn/pr_notice/pr_debug become
	  no-ops. Only pr_err and pr_alert are preserved for
	  critical errors. This prevents KSU detection via dmesg.

endmenu
```
